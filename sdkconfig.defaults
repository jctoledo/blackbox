## sdkconfig.defaults
```kconfig
CONFIG_IDF_TARGET="esp32c3"
CONFIG_FREERTOS_HZ=1000
CONFIG_ESP_MAIN_TASK_STACK_SIZE=8192
CONFIG_ESP_SYSTEM_EVENT_TASK_STACK_SIZE=4096
CONFIG_ESPTOOLPY_FLASHSIZE_4MB=y
# Custom partition table with 2.5 MB app partition (vs 1.5 MB default)
# NOTE: Path must be absolute - run ./scripts/setup-partition.sh after cloning
CONFIG_PARTITION_TABLE_CUSTOM=y
CONFIG_PARTITION_TABLE_CUSTOM_FILENAME="/home/jose/Documents/code/blackbox/partitions.csv"
CONFIG_COMPILER_OPTIMIZATION_SIZE=y

# Enable newlib
CONFIG_NEWLIB_NANO_FORMAT=n
CONFIG_NEWLIB_STDOUT_LINE_ENDING_CRLF=y

# Enable pthread support
CONFIG_PTHREAD_TASK_PRIO_DEFAULT=5
CONFIG_PTHREAD_TASK_STACK_SIZE_DEFAULT=3072

# FreeRTOS config
CONFIG_FREERTOS_UNICORE=n
CONFIG_FREERTOS_TIMER_TASK_STACK_DEPTH=2048

# Free UART0 for GPS by using USB-JTAG for logging
#CONFIG_ESP_CONSOLE_USB_SERIAL_JTAG=y
#CONFIG_ESP_CONSOLE_SECONDARY_NONE=y
CONFIG_ESP_CONSOLE_NONE=y

# WiFi Configuration
CONFIG_ESP32C3_WIFI_STATIC_RX_BUFFER_NUM=10
CONFIG_ESP32C3_WIFI_DYNAMIC_RX_BUFFER_NUM=32
CONFIG_ESP32C3_WIFI_DYNAMIC_TX_BUFFER_NUM=32
CONFIG_ESP_WIFI_NVS_ENABLED=y

# LWIP (networking stack)
CONFIG_LWIP_MAX_SOCKETS=16
CONFIG_LWIP_SO_REUSE=y
CONFIG_LWIP_SO_RCVBUF=y

# MQTT
CONFIG_MQTT_PROTOCOL_311=y
CONFIG_MQTT_TRANSPORT_SSL=n
CONFIG_MQTT_TRANSPORT_WEBSOCKET=n

# HTTP Server with WebSocket support
CONFIG_HTTPD_MAX_REQ_HDR_LEN=1024
CONFIG_HTTPD_MAX_URI_LEN=512
CONFIG_HTTPD_WS_SUPPORT=y

# WiFi AP mode support
CONFIG_ESP_WIFI_SOFTAP_SUPPORT=y
CONFIG_LWIP_DHCPS=y
```

## sensors/active-wing/sdkconfig.defaults
```kconfig
# ESP32-C3 configuration
CONFIG_IDF_TARGET="esp32c3"

# Use built-in large partition table (3MB app partition)
# CONFIG_PARTITION_TABLE_SINGLE_APP is not set
CONFIG_PARTITION_TABLE_SINGLE_APP_LARGE=y

# Flash size
CONFIG_ESPTOOLPY_FLASHSIZE_4MB=y
CONFIG_ESPTOOLPY_FLASHSIZE="4MB"

# Optimize binary size
CONFIG_COMPILER_OPTIMIZATION_SIZE=y
CONFIG_COMPILER_OPTIMIZATION_ASSERTIONS_DISABLE=y

# WiFi/Bluetooth
CONFIG_BT_ENABLED=n
CONFIG_BT_BLUEDROID_ENABLED=n
CONFIG_BT_NIMBLE_ENABLED=n
```

## sensors/blackbox/sdkconfig.defaults
```kconfig
# ESP32-C3 configuration
CONFIG_IDF_TARGET="esp32c3"

# Custom partition table with 2.5 MB app partition (vs 1.5 MB default)
CONFIG_PARTITION_TABLE_CUSTOM=y
CONFIG_PARTITION_TABLE_CUSTOM_FILENAME="partitions.csv"

# Flash size
CONFIG_ESPTOOLPY_FLASHSIZE_4MB=y
CONFIG_ESPTOOLPY_FLASHSIZE="4MB"

# Optimize binary size
CONFIG_COMPILER_OPTIMIZATION_SIZE=y
CONFIG_COMPILER_OPTIMIZATION_ASSERTIONS_DISABLE=y

# WiFi/Bluetooth
CONFIG_BT_ENABLED=n
CONFIG_BT_BLUEDROID_ENABLED=n
CONFIG_BT_NIMBLE_ENABLED=n

# Enable USB-JTAG logging (needed since UART0 is used for GPS)
CONFIG_ESP_CONSOLE_USB_SERIAL_JTAG=y
CONFIG_ESP_CONSOLE_SECONDARY_USB_SERIAL_JTAG=y

# HTTP Server with WebSocket support
CONFIG_HTTPD_MAX_REQ_HDR_LEN=1024
CONFIG_HTTPD_MAX_URI_LEN=512
CONFIG_HTTPD_WS_SUPPORT=y

# WiFi AP mode settings
CONFIG_ESP_WIFI_SOFTAP_SUPPORT=y
CONFIG_LWIP_DHCPS=y
```

## tools/uart_bridge/sdkconfig.defaults
```kconfig
# ESP32-C3 configuration for WT901 config tool
CONFIG_IDF_TARGET="esp32c3"

# Use built-in large partition table (3MB app partition)
CONFIG_PARTITION_TABLE_SINGLE_APP_LARGE=y

# Flash size
CONFIG_ESPTOOLPY_FLASHSIZE_4MB=y
CONFIG_ESPTOOLPY_FLASHSIZE="4MB"

# Optimize binary size
CONFIG_COMPILER_OPTIMIZATION_SIZE=y

# Disable Bluetooth (not needed)
CONFIG_BT_ENABLED=n

# Use USB-JTAG for console output (frees UART0/UART1 for sensors)
CONFIG_ESP_CONSOLE_USB_SERIAL_JTAG=y

# FreeRTOS tick rate
CONFIG_FREERTOS_HZ=1000
```
